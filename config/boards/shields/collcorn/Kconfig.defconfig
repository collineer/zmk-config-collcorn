## config/boards/shields/collcorn/Kconfig.defconfig
```kconfig
if SHIELD_COLLCORN_LEFT

config ZMK_KEYBOARD_NAME
    default "collcorn"

config ZMK_SPLIT_ROLE_CENTRAL
    default y

endif

if SHIELD_COLLCORN_LEFT || SHIELD_COLLCORN_RIGHT

config ZMK_SPLIT
    default y

endif
```

## config/boards/shields/collcorn/Kconfig.shield
```kconfig
config SHIELD_COLLCORN_LEFT
    def_bool $(shields_list_contains,collcorn_left)

config SHIELD_COLLCORN_RIGHT
    def_bool $(shields_list_contains,collcorn_right)
```
